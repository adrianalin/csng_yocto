## meta-crankshaft/conf/bblayers.conf.sample
```bitbake
# POKY_BBLAYERS_CONF_VERSION is increased each time build/conf/bblayers.conf
# changes incompatibly
POKY_BBLAYERS_CONF_VERSION = "2"

BBPATH = "${TOPDIR}"
BBFILES ?= ""

BBLAYERS ?= " \
  ${HOME}/workspace/poky/meta \
  ${HOME}/workspace/poky/meta-poky \
  ${HOME}/workspace/poky/meta-openembedded/meta-oe \
  ${HOME}/workspace/poky/meta-openembedded/meta-multimedia \
  ${HOME}/workspace/poky/meta-openembedded/meta-networking \
  ${HOME}/workspace/poky/meta-openembedded/meta-perl \
  ${HOME}/workspace/poky/meta-openembedded/meta-python \
  ${HOME}/workspace/poky/meta-openembedded/meta-filesystems \
  ${HOME}/workspace/poky/meta-qt5 \
  ${HOME}/workspace/poky/meta-raspberrypi \
  ${HOME}/workspace/poky/csng_yocto/meta-crankshaft \
  "
```
